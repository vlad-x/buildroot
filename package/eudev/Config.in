## package/eudev/Config.in
```kconfig
# Note: being prompt-less, and selected in the /dev management choice,
# it is not needed to have dependencies on this symbol, since the
# choice entry already have those dependencies.
# However, it seems more logical to have the dependencies listed here,
# so it is easier to uderstand why we have those, and duplicate them in
# the choice entry.
#
# Note, although named 'eudev', this package primarily provides libudev,
# unless the /dev management is selected to be eudev, in which case this
# package will provide a full udev. That's why the prompt is 'libudev'.

config BR2_PACKAGE_EUDEV
	bool "libudev"
	depends on !BR2_avr32 # no __NR_name_to_handle_at
	depends on BR2_USE_WCHAR
	depends on !BR2_PREFER_STATIC_LIB
	depends on !BR2_PACKAGE_SYSTEMD
	select BR2_PACKAGE_HAS_LIBUDEV if !BR2_PACKAGE_EUDEV_DAEMON
	help
	  eudev is a fork of systemd-udev with the goal of obtaining better
	  compatibility with existing software.

	  This installs only the libudev library.

	  http://www.gentoo.org/proj/en/eudev/

if BR2_PACKAGE_EUDEV

config BR2_PACKAGE_EUDEV_DAEMON
	bool
	depends on !BR2_avr32 # no epoll_create1
	depends on BR2_USE_MMU # uses fork()
	depends on BR2_LARGEFILE # util-linux
	depends on BR2_USE_WCHAR # util-linux
	depends on !BR2_PREFER_STATIC_LIB # kmod
	select BR2_PACKAGE_HAS_LIBUDEV
	select BR2_PACKAGE_HAS_UDEV
	select BR2_PACKAGE_UTIL_LINUX
	select BR2_PACKAGE_UTIL_LINUX_LIBBLKID
	select BR2_PACKAGE_KMOD

if BR2_PACKAGE_EUDEV_DAEMON

config BR2_PACKAGE_PROVIDES_LIBUDEV
	default "eudev"

config BR2_PACKAGE_PROVIDES_UDEV
	default "eudev"

config BR2_PACKAGE_EUDEV_RULES_GEN
	bool "eudev rules generator"
	help
	  Enable persistent rules generator

endif # BR2_PACKAGE_EUDEV_DAEMON

# If the daemon is selected, it means we have a full udev, which is
# responsible for providing libudev. So only provide libudev if the
# daemon is not selected.
config BR2_PACKAGE_PROVIDES_LIBUDEV
	default "eudev" if !BR2_PACKAGE_EUDEV_DAEMON

endif # BR2_PACKAGE_EUDEV

comment "libudev needs a toolchain w/ wchar, dynamic library"
	depends on !BR2_USE_WCHAR || BR2_PREFER_STATIC_LIB
	depends on !BR2_PACKAGE_SYSTEMD

comment "libudev provided by systemd"
	depends on BR2_PACKAGE_SYSTEMD
```

## package/initscripts/Config.in
```kconfig
config BR2_PACKAGE_INITSCRIPTS
	bool "initscripts"
	depends on BR2_INIT_BUSYBOX || BR2_INIT_SYSV
	help
	  The basics startup scripts for both SysV and Busybox
```

## package/libatasmart/Config.in
```kconfig
config BR2_PACKAGE_LIBATASMART
	bool "libatasmart"
	depends on BR2_PACKAGE_HAS_LIBUDEV
	help
	  The libatasmart package is a disk reporting library.
	  It only supports a subset of the ATA S.M.A.R.T. functionality.

	  http://0pointer.de/blog/projects/being-smart.html
```

## package/libconnman-qt/Config.in
```kconfig
config BR2_PACKAGE_LIBCONNMAN_QT
	bool "libconnman-qt"
	depends on BR2_INSTALL_LIBSTDCPP
	# Qt5 is a big library, we don't want to select it
	# automatically without the user knowing
	depends on BR2_PACKAGE_QT || BR2_PACKAGE_QT5
	depends on BR2_TOOLCHAIN_HAS_THREADS
	help
	  Qt bindings for ConnMan

	  https://github.com/nemomobile/libconnman-qt

comment "libconnman-qt needs a toolchain w/ C++, threads"
	depends on !BR2_INSTALL_LIBSTDCPP || !BR2_TOOLCHAIN_HAS_THREADS

comment"libconnman-qt need Qt"
	depends on !(BR2_PACKAGE_QT || BR2_PACKAGE_QT5)
```

## package/libressl/Config.in
```kconfig
config BR2_PACKAGE_LIBRESSL
	bool "libressl"
	depends on BR2_LARGEFILE
	depends on BR2_TOOLCHAIN_HAS_THREADS
	help
	  LibreSSL is a FREE version of the SSL/TLS protocol forked from OpenSSL

	  http://www.libressl.org/

comment "libressl needs a toolchain w/ largefile, threads"
	depends on !BR2_LARGEFILE || !BR2_TOOLCHAIN_HAS_THREADS
```

## package/linux-zigbee/Config.in
```kconfig
config BR2_PACKAGE_LINUX_ZIGBEE
	bool "linux-zigbee"
	depends on BR2_USE_MMU # fork()
	select BR2_PACKAGE_LIBNL
	help
	  IEEE 802.15.4 userspace tools.

	  Note: The name's project is somewhat of a misnomer, because of licensing
	  issues this does *NOT* implement ZigBee, only IEEE 802.15.4 and 6LoWPAN.

	  http://sourceforge.net/apps/trac/linux-zigbee/

if BR2_PACKAGE_LINUX_ZIGBEE

config BR2_PACKAGE_LINUX_ZIGBEE_TESTS
	bool "Install tests programs"
	help
		Linux-ZigBee build tests programs, select this if you want to install
		them.

config BR2_PACKAGE_LINUX_ZIGBEE_OLD_KERNEL_COMPAT
	bool "Enable compatibility with older kernels"

config BR2_PACKAGE_LINUX_ZIGBEE_LEASEFILE
	string "Specify path for persistent lease storage."
	default "/var/run/izcoordinator.leases"

endif
```

## package/spidermonkey/Config.in
```kconfig
config BR2_PACKAGE_SPIDERMONKEY
	bool "spidermonkey"
	help
	  SpiderMonkey is the code name for the first-ever JavaScript engine.

	  https://developer.mozilla.org/en-US/docs/Mozilla/Projects/SpiderMonkey
```

## package/systemd-bootchart/Config.in
```kconfig
config BR2_PACKAGE_SYSTEMD_BOOTCHART_ARCH_SUPPORTS
	bool
	# see src/shared/architecture.h
	default y if BR2_arm || BR2_armeb || BR2_i386 || BR2_mips || \
		BR2_mipsel || BR2_powerpc || BR2_powerpc64 || \
		BR2_powerpc64le || BR2_sh4 || BR2_sh4eb || \
		BR2_sh4a || BR2_sh4aeb || BR2_sparc || BR2_x86_64 || \
		BR2_aarch64 || BR2_m68k

config BR2_PACKAGE_SYSTEMD_BOOTCHART
	bool "systemd-bootchart"
	depends on BR2_INIT_SYSTEMD
	depends on BR2_USE_WCHAR # util-linux
	depends on !BR2_STATIC_LIBS # kmod
	depends on BR2_TOOLCHAIN_HAS_THREADS # dbus
	depends on BR2_USE_MMU # dbus
	help
	  systemd-bootchart is a tool, usually run at system startup,
	  that collects the CPU load, disk load, memory usage, as well
	  as per-process information from a running system. Collected
	  results are output as an SVG graph.

	  systemd-bootchart requires a Linux kernel >= 3.0 with the following
	  options enabled:

	  - CONFIG_SCHEDSTATS
	  - CONFIG_SCHED_DEBUG

	  These options will be automatically enabled by Buildroot if
	  it is responsible for building the kernel. Otherwise, if you
	  are building your kernel outside of Buildroot, make sure
	  these options are enabled.

	  http://www.freedesktop.org/software/systemd/man/systemd-bootchart.html
```

## package/systemd/Config.in
```kconfig
config BR2_PACKAGE_SYSTEMD_ARCH_SUPPORTS
	bool
	# see src/shared/architecture.h
	default y if BR2_arm || BR2_armeb || BR2_i386 || BR2_mips || \
		BR2_mipsel || BR2_powerpc || BR2_powerpc64 || \
		BR2_powerpc64le || BR2_sh4 || BR2_sh4eb || \
		BR2_sh4a || BR2_sh4aeb || BR2_sparc || BR2_x86_64 || \
		BR2_aarch64 || BR2_m68k

# Note: being prompt-less, and selected in the /dev management choice,
# it is not needed to have dependencies on this symbol, since the
# choice entry already have those dependencies.
# However, it seems more logical to have the dependencies listed here,
# so it is easier to uderstand why we have those, and duplicate them in
# the choice entry.

config BR2_PACKAGE_SYSTEMD
	bool
	depends on BR2_PACKAGE_SYSTEMD_ARCH_SUPPORTS
	depends on BR2_TOOLCHAIN_USES_GLIBC
	depends on BR2_INET_IPV6
	depends on BR2_TOOLCHAIN_HAS_SSP
	depends on BR2_TOOLCHAIN_HEADERS_AT_LEAST_3_8
	depends on BR2_LARGEFILE # util-linux
	depends on BR2_USE_WCHAR # util-linux
	depends on !BR2_PREFER_STATIC_LIB # kmod
	depends on BR2_TOOLCHAIN_HAS_THREADS # dbus
	depends on BR2_USE_MMU # dbus
	select BR2_PACKAGE_HAS_UDEV
	select BR2_PACKAGE_DBUS # runtime dependency only
	select BR2_PACKAGE_LIBCAP
	select BR2_PACKAGE_UTIL_LINUX
	select BR2_PACKAGE_UTIL_LINUX_LIBBLKID
	select BR2_PACKAGE_KMOD
	select BR2_PACKAGE_BUSYBOX_SHOW_OTHERS # kmod-tools
	select BR2_PACKAGE_KMOD_TOOLS

if BR2_PACKAGE_SYSTEMD

menu "systemd"

config BR2_PACKAGE_PROVIDES_UDEV
	default "systemd"

config BR2_PACKAGE_SYSTEMD_ALL_EXTRAS
	bool "enable all extras"
	select BR2_PACKAGE_XZ
	select BR2_PACKAGE_LIBGCRYPT
	help
	  Enable extra features for Systemd: journal compression and
	  signing.

config BR2_PACKAGE_SYSTEMD_JOURNAL_GATEWAY
	bool "HTTP server for journal events"
	select BR2_PACKAGE_LIBMICROHTTPD
	help
	  systemd-journal-gatewayd serves journal events over the
	  network. Clients must connect using HTTP. The server
	  listens on port 19531 by default.

	  http://www.freedesktop.org/software/systemd/man/systemd-journal-gatewayd.service.html

config BR2_PACKAGE_SYSTEMD_NETWORKD
	bool "enable network manager"
	help
	  systemd-networkd is a system service that manages networks.
	  It detects and configures network devices as they appear, as well as
	  creating virtual network devices.

	  This simple network configuration solution is an alternative to
	  dhcpcd or ISC dhcp.

	  http://www.freedesktop.org/software/systemd/man/systemd-networkd.html

config BR2_PACKAGE_SYSTEMD_TIMESYNCD
	bool "enable SNTP client"
	depends on BR2_PACKAGE_SYSTEMD_NETWORKD
	help
	  systemd-timesyncd is a service that may be used to synchronize the
	  local system clock with a Network Time Protocol Server.

	  This simple NTP solution is an alternative to sntp/ntpd from the ntp
	  package.

	  http://www.freedesktop.org/software/systemd/man/systemd-timesyncd.html

config BR2_PACKAGE_SYSTEMD_COMPAT
	bool "enable compatibility libraries"
	help
	  Since systemd 209, the following libraries have been merged into
	  libsystemd.so:

	  - libsystemd-daemon
	  - libsystemd-id128
	  - libsystemd-journal
	  - libsystemd-login

	  This option enables the installation of compatibility *.pc files.

config BR2_PACKAGE_SYSTEMD_SMACK_SUPPORT
	bool "enable SMACK support"
	select BR2_PACKAGE_ATTR
	select BR2_PACKAGE_SMACK
	help
	  Enable support for SMACK, the Simple Mandatory Access Control
	  Kernel, a minimal approach to Access Control implemented as a kernel
	  LSM.

	  This feature requires a kernel >= 3.8.

	  When this feature is enabled, Systemd mounts smackfs and manages
	  security labels for sockets.

endmenu # "systemd"

endif
```
